## config/boards/shields/limoncello/Kconfig.defconfig
```kconfig
if SHIELD_LIMONCELLO_LEFT_CENTRAL ||SHIELD_LIMONCELLO_CENTRAL || SHIELD_LIMONCELLO_LEFT || SHIELD_LIMONCELLO_RIGHT

config ZMK_KEYBOARD_NAME
    default "LIMONCELLO"

config ZMK_SPLIT
    default y

endif #SHIELD_LIMONCELLO_LEFT_CENTRAL ||SHIELD_LIMONCELLO_CENTRAL || SHIELD_LIMONCELLO_LEFT || SHIELD_LIMONCELLO_RIGHT

# Centrals
if SHIELD_LIMONCELLO_CENTRAL || SHIELD_LIMONCELLO_LEFT_CENTRAL

config ZMK_SPLIT_ROLE_CENTRAL
    default y

config ZMK_SPLIT_BLE_CENTRAL_BATTERY_LEVEL_FETCHING
    default y

# Set this to ZMK_SPLIT_BLE_CENTRAL_PERIPHERALS + your desired number of BT profiles (default is 5)
config BT_MAX_CONN
    default 5

# Set this to the same number as BT_MAX_CONN
config BT_MAX_PAIRED
    default 5
    
if ZMK_DISPLAY

config I2C
    default y

config SSD1306
    default y

choice ZMK_DISPLAY_WORK_QUEUE
    default ZMK_DISPLAY_WORK_QUEUE_DEDICATED
endchoice

endif # ZMK_DISPLAY

## Display Setup
if LVGL

config LV_Z_VDB_SIZE
    default 64

config LV_DPI_DEF
    default 148

config LV_Z_BITS_PER_PIXEL
    default 1

choice LV_COLOR_DEPTH
    default LV_COLOR_DEPTH_1
endchoice

endif # LVGL

endif # SHIELD_LIMONCELLO_CENTRAL_DONGLE || SHIELD_LIMONCELLO_LEFT_CENTRAL

if SHIELD_LIMONCELLO_LEFT_CENTRAL
    config ZMK_SPLIT_BLE_CENTRAL_PERIPHERALS
        default 1
endif

if SHIELD_LIMONCELLO_CENTRAL
    config ZMK_SPLIT_BLE_CENTRAL_PERIPHERALS
        default 2
endif

# RGB STUFF
if SHIELD_LIMONCELLO_LEFT_CENTRAL || SHIELD_LIMONCELLO_LEFT || SHIELD_LIMONCELLO_RIGHT

config SPI
    default y

config ZMK_RGB_UNDERGLOW
    default y
    select WS2812_STRIP
    select SPI

config ZMK_RGB_UNDERGLOW_BRT_START
    default 50

config ZMK_RGB_UNDERGLOW_EFF_START
    default 3

endif # SHIELD_LIMONCELLO_LEFT_CENTRAL || SHIELD_LIMONCELLO_LEFT || SHIELD_LIMONCELLO_RIGHT
```

## config/boards/shields/limoncello/Kconfig.shield
```kconfig
# Copyright (c) 2022 The ZMK Contributors
# SPDX-License-Identifier: MIT
config SHIELD_LIMONCELLO_CENTRAL
    def_bool $(shields_list_contains,limoncello_central)

config SHIELD_LIMONCELLO_LEFT_CENTRAL
    def_bool $(shields_list_contains,limoncello_left_central)

config SHIELD_LIMONCELLO_LEFT
    def_bool $(shields_list_contains,limoncello_left)

config SHIELD_LIMONCELLO_RIGHT
    def_bool $(shields_list_contains,limoncello_right)
```

## config/west.yml
```yaml
manifest:
  defaults:
    remote: urob
    revision: v0.3
  remotes:
    - name: zmkfirmware
      url-base: https://github.com/zmkfirmware
    - name: urob
      url-base: https://github.com/urob
    - name: englmaxi
      url-base: https://github.com/englmaxi
    - name: dhruvinsh
      url-base: https://github.com/dhruvinsh
    - name: rianadon
      url-base: https://github.com/rianadon
  projects:
    - name: zmk
      remote: zmkfirmware
      revision: main
      import: app/west.yml
    - name: zmk-tri-state
      path: modules/zmk/tri-state
    - name: zmk-helpers
      path: modules/zmk/helpers
    - name: zmk-dongle-display
      remote: englmaxi
      revision: main # v0.3
    - name: cosmos-zmk-module
      remote: rianadon
      revision: main
      # import: config/deps.yml
  self:
    path: config
    # import: deps.yml
```
