## config/boards/shields/cosmos/Kconfig.defconfig
```kconfig
# Copyright (c) 2022 The ZMK Contributors
# SPDX-License-Identifier: MIT

if SHIELD_COSMOS_CENTRAL || SHIELD_COSMOS_LEFT_CENTRAL

config ZMK_KEYBOARD_NAME
    default "Cosmos"

config ZMK_SPLIT_ROLE_CENTRAL
    default y

config BT_MAX_CONN # 2 peripherals and 3 BT profiles
    default 5

config BT_MAX_PAIRED # 2 peripherals and 3 BT profiles
    default 5
endif


if SHIELD_COSMOS_CENTRAL

config ZMK_SPLIT_BLE_CENTRAL_PERIPHERALS
  default 2

endif


if SHIELD_COSMOS_LEFT_CENTRAL

config ZMK_SPLIT_BLE_CENTRAL_PERIPHERALS
  default 1

endif


if SHIELD_COSMOS_LEFT || SHIELD_COSMOS_RIGHT || SHIELD_COSMOS_CENTRAL || SHIELD_COSMOS_LEFT_CENTRAL

config ZMK_SPLIT
    default y

endif
```

## config/boards/shields/cosmos/Kconfig.shield
```kconfig
# Copyright (c) 2022 The ZMK Contributors
# SPDX-License-Identifier: MIT
config SHIEILD_COSMOS_CENTRAL
    def_bool $(shields_list_contains,cosmos_central)

config SHIELD_COSMOS_LEFT_CENTRAL
    def_bool $(shields_list_contains,cosmos_left_central)

config SHIELD_COSMOS_LEFT
    def_bool $(shields_list_contains,cosmos_left)

config SHIELD_COSMOS_RIGHT
    def_bool $(shields_list_contains,cosmos_right)
```

## config/boards/shields/cygnus/Kconfig.defconfig
```kconfig
if SHIELD_CYGNUS_CENTRAL_DONGLE || SHIELD_CYGNUS_CENTRAL_LEFT

config ZMK_KEYBOARD_NAME
    default "Cygnus"

config ZMK_SPLIT_ROLE_CENTRAL
    default y

config ZMK_SPLIT_BLE_CENTRAL_BATTERY_LEVEL_FETCHING
    default y

# Set this to ZMK_SPLIT_BLE_CENTRAL_PERIPHERALS + your desired number of BT profiles (default is 5)
config BT_MAX_CONN
    default 5

# Set this to the same number as BT_MAX_CONN
config BT_MAX_PAIRED
    default 5
    
if ZMK_DISPLAY

config I2C
    default y

config SSD1306
    default y

choice ZMK_DISPLAY_WORK_QUEUE
    default ZMK_DISPLAY_WORK_QUEUE_DEDICATED
endchoice

endif

if LVGL

config LV_Z_VDB_SIZE
    default 64

config LV_DPI_DEF
    default 148

config LV_Z_BITS_PER_PIXEL
    default 1

choice LV_COLOR_DEPTH
    default LV_COLOR_DEPTH_1
endchoice

endif

endif

if SHIELD_CYGNUS_CENTRAL_LEFT ||SHIELD_CYGNUS_CENTRAL_DONGLE || SHIELD_CYGNUS_PERIPHERAL_LEFT || SHIELD_CYGNUS_PERIPHERAL_RIGHT

config ZMK_SPLIT
    default y

endif

if SHIELD_CYGNUS_CENTRAL_LEFT
    config ZMK_SPLIT_BLE_CENTRAL_PERIPHERALS
        default 1
endif

if SHIELD_CYGNUS_CENTRAL_DONGLE
    config ZMK_SPLIT_BLE_CENTRAL_PERIPHERALS
        default 2
endif
```
