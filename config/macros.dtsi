/* Homerow Mods */
#define MAKE_HT(NAME, MODE, HOLD, TAP, TRIGGER_POS) \
    ZMK_BEHAVIOR(NAME, hold_tap, \
        flavor = MODE; \
        tapping-term-ms = <TAPPING_TERM>; \
        quick-tap-ms = <QUICK_TAP_MS>; \
        bindings = <HOLD>, <TAP>; \
        require-prior-idle-ms = <PRIOR_IDLE_MS>; \
        hold-trigger-key-positions = <TRIGGER_POS>; \
    )

#define MAKE_HRM(NAME, HOLD, TAP, TRIGGER_POS) \
    MAKE_HT(NAME, "tap-preferred", HOLD, TAP, TRIGGER_POS)

MAKE_HRM(hrm_left, &kp, &kp, KEYS_R THUMBS)
MAKE_HRM(hrm_right, &kp, &kp, KEYS_L THUMBS)
MAKE_HRM(hrl_left, &mo, &kp, KEYS_R THUMBS)
MAKE_HRM(hrl_right, &mo, &kp, KEYS_L THUMBS)

#define SL(KEY) &hrm_left SFT KEY
#define CL(KEY) &hrm_left CTL KEY
#define AL(KEY) &hrm_left ALT KEY
#define ML(KEY) &hrm_left MET KEY

#define SR(KEY) &hrm_right SFT KEY
#define CR(KEY) &hrm_right CTL KEY
#define AR(KEY) &hrm_right ALT KEY
#define MR(KEY) &hrm_right MET KEY

#define SYL(KEY) &hrl_left SYS KEY
#define SYR(KEY) &hrl_right SYS KEY

MAKE_HRM(mts, &sk, &caps_word, KEYS_L KEYS_R)
MAKE_HRM(mtb, &sk, &bsdel, KEYS_L KEYS_R)
MAKE_HRM(lts, &mo, &caps_word, KEYS_L KEYS_R)

MAKE_HT(thl, "tap-preferred", &mo, &kp, KEYS_L KEYS_R THUMBS)
MAKE_HT(thm, "tap-preferred", &kp, &kp, KEYS_L KEYS_R THUMBS)

MAKE_HT(mt_bsdel, "hold-preferred", &kp, &bsdel, KEYS_L KEYS_R THUMBS)
MAKE_HT(lt_bsdel, "hold-preferred", &mo, &bsdel, KEYS_L KEYS_R THUMBS)

MAKE_HT(lt_comm, "tap-preferred", &mo, &com_sem, KEYS_R)

/* Mod Morphs */
#define NUM_MORPH(NAME, KEY1, KEY2) ZMK_MOD_MORPH(NAME,\
  bindings = <&kp KEY1>, <&kp KEY2>;\
  mods = <(MOD_LGUI|MOD_LALT)>;\
  keep-mods = <(MOD_LGUI|MOD_LALT)>;\
)

/* Layer Macros */
#define _LAYER(NAME, LT, RT, LM, RM, LB, RB, LH, RH) \
  ZMK_LAYER(NAME, \
    X_LT LT      RT X_RT \
    X_LM LM      RM X_RM \
    X_LB LB      RB X_RB \
    X_LH LH X_MH RH X_RH \
  )
#define LAYER(NAME, LT, RT, LM, RM, LB, RB) _LAYER(NAME, LT, RT, LM, RM, LB, RB, LEFT_THUMBS, RIGHT_THUMBS)
#define MLAYER(NAME, LT, RT, LM, RM, LB, RB) _LAYER(##NAME##_mac, LT, RT, LM, RM, LB, RB, LEFT_THUMBS_MAC, RIGHT_THUMBS_MAC)
#define TLAYER(NAME, LT, RT, LM, RM, LB, RB) _LAYER(NAME, LT, RT, LM, RM, LB, RB, TRANS_THUMBS, TRANS_THUMBS)
#define TRANS_LAYER(NAME) LAYER(NAME, TRANS_5, TRANS_5, TRANS_5, TRANS_5, TRANS_5, TRANS_5)

/* Combo Macros */
#define SIMPLE_COMBO(NAME, KEY, COMBO_KEYS) \
ZMK_COMBO(NAME, KEY, COMBO_KEYS, COMBO_LAYERS, COMBO_TERM, COMBO_TERM)

/* Mod Combos */
// This system utilizes the slow-release property to keep the layer enabled while one of the combo keys is active.
// This essentially allows the one-shot keys to be activated by either sequencing of the layer and mod key, instead of
// having to always press the layer key first.
#define MOD_LAYER_COMBO(MOD, LAYER, POSITIONS) \ 
        ZMK_BEHAVIOR(macro_##MOD##_##LAYER, macro, wait-ms = <0>; tap-ms = <0>; \
        bindings \
            = <&macro_press &mo LAYER> \
            , <&macro_press &sk MOD> \
            , <&macro_pause_for_release> \
            , <&macro_release &sk MOD> \
            , <&macro_release &mo LAYER> \
            ; \
    ) \
    ZMK_COMBO(combo_##MOD##_##LAYER, &macro_##MOD##_##LAYER, POSITIONS, COMBO_LAYERS, COMBO_TERM, COMBO_TERM, slow-release;)

#define MOD_LAYER_COMBO_2(MOD1, MOD2, LAYER, POSITIONS) \ 
        ZMK_BEHAVIOR(macro_##MOD1##_##MOD2##_##LAYER, macro, wait-ms = <0>; tap-ms = <0>; \
        bindings \
            = <&macro_press &mo LAYER> \
            , <&macro_press &sk MOD1> \
            , <&macro_press &sk MOD2> \
            , <&macro_pause_for_release> \
            , <&macro_release &sk MOD2> \
            , <&macro_release &sk MOD1> \
            , <&macro_release &mo LAYER> \
            ; \
    ) \
    ZMK_COMBO(combo_##MOD1##_##MOD2##_##LAYER, &macro_##MOD1##_##MOD2##_##LAYER, POSITIONS, COMBO_LAYERS, COMBO_TERM, COMBO_TERM, slow-release;)

