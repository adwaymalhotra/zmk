/* Aliases */
#define GR     0
#define GRM    1
#define QW     2
#define QWM    3
#define GAME   4
#define NAV    5
#define NAVM   6
#define SYM    7
#define SYMM   8
#define FN     9
#define FNM   10
#define SYS   11

#define ALT LALT
#define MET LGUI
#define SFT LSHFT
#define CTL LCTL

/* Timings */
#define PRIOR_IDLE_MS 160
#define QUICK_TAP_MS 175
#define TAPPING_TERM 200

#undef COMBO_TERM
#define COMBO_TERM 50
#define COMBO_LAYERS GR QW NAV SYM GRM QWM NAVM SYMM

/* ZMK Core Features */
#include <behaviors.dtsi>
#include <dt-bindings/zmk/bt.h>
#include <dt-bindings/zmk/outputs.h>
/* urob's helper (must be after including behaviors.dtsi) */
#include <zmk-helpers/helper.h>
/* my definitions */
#include "extra_keys.h"
#include "keys_en_gb_extended.h"
#include "macros.dtsi"

/* All Other Behaviors */
&sk {
    release-after-ms = <1000>;
    quick-release;
};

&lt {
  tapping-term-ms = <TAPPING_TERM>;
  quick-tap-ms = <QUICK_TAP_MS>;
  flavor = "hold-preferred";
};

&mt {
  tapping-term-ms = <TAPPING_TERM>;
  quick-tap-ms = <QUICK_TAP_MS>;
  flavor = "hold-preferred";
};

&caps_word {
  continue-list = <UNDERSCORE MINUS BACKSPACE DELETE>;
  /delete-property/ ignore-modifiers;
};

ZMK_KEY_TOGGLE(kt_off, toggle-mode = "off";)
ZMK_KEY_TOGGLE(kt_on, toggle-mode = "on";)

/* Tri State for Alt-Tab in a layer. */
ZMK_TRI_STATE(alt_tab, bindings = <&kt_on LALT>, <&kp TAB>, <&kt_off LALT>; ignored-key-positions = <LT3>;)
ZMK_TRI_STATE(ctl_tab, bindings = <&kt_on LCTL>, <&kp TAB>, <&kt_off LCTL>; ignored-key-positions = <LT3>;)
ZMK_TRI_STATE(met_tab, bindings = <&kt_on LGUI>, <&kp TAB>, <&kt_off LGUI>; ignored-key-positions = <LT3>;)

/* Macros */
ZMK_MACRO(uc_deg,  bindings = <&kp RALT>, <&kp O>,           <&kp O>  ;)
ZMK_MACRO(uc_gbp,  bindings = <&kp RALT>, <&kp LS(L)>,       <&kp EQL>;)
ZMK_MACRO(uc_eur,  bindings = <&kp RALT>, <&kp C>,           <&kp EQL>;)
ZMK_MACRO(uc_rup,  bindings = <&kp RALT>, <&kp R>,           <&kp EQL>;)
ZMK_MACRO(vi_sav,  bindings = <&kp ESC>,  <&kp COLON &kp W>, <&kp RET>; wait-ms =<20>;)
ZMK_MACRO(find,    bindings = <&kp LC(F)>;)
ZMK_MACRO(pre_wor, bindings = <&kp LC(LEFT)>;)
ZMK_MACRO(nex_wor, bindings = <&kp LC(RIGHT)>;)
ZMK_MACRO(pre_tab, bindings = <&kp LC(LS(TAB))>;)
ZMK_MACRO(nex_tab, bindings = <&kp LC(TAB)>;)
ZMK_MACRO(pre_dsk, bindings = <&kp LC(LG(LEFT))>;)
ZMK_MACRO(nex_dsk, bindings = <&kp LC(LG(RIGHT))>;)
ZMK_MACRO(cut,     bindings = <&kp LC(X)>;)
ZMK_MACRO(copy,    bindings = <&kp LC(C)>;)
ZMK_MACRO(paste,   bindings = <&kp LC(V)>;)
ZMK_MACRO(half_dn, bindings = <&kp LC(D)>;)
ZMK_MACRO(half_up, bindings = <&kp LC(U)>;)
ZMK_MACRO(del_wor, bindings = <&kp LC(BSPC)>;)

/* Morphs */
ZMK_MOD_MORPH(bsdel,    bindings = <&kp BACKSPACE>, <&kp DELETE>; mods = <(MOD_LALT|MOD_LGUI|MOD_LSFT)>;)
ZMK_MOD_MORPH(dlr_gbp,  bindings = <&kp DLLR>, <&uc_gbp>        ; mods = <(MOD_LSFT|MOD_RSFT)>;)
ZMK_MOD_MORPH(amps_eur, bindings = <&kp AMPS>, <&uc_eur>        ; mods = <(MOD_LSFT|MOD_RSFT)>;)
ZMK_MOD_MORPH(star_rup, bindings = <&kp STAR>, <&uc_rup>        ; mods = <(MOD_LSFT|MOD_RSFT)>;)
ZMK_MOD_MORPH(dot_col,  bindings = <&kp DOT>, <&kp COLON>       ; mods = <(MOD_LSFT)>;)
ZMK_MOD_MORPH(com_sem,  bindings = <&kp COMMA>, <&kp SEMICOLON> ; mods = <(MOD_LSFT)>;)
ZMK_MOD_MORPH(sqt_dqt,  bindings = <&kp SQT>, <&kp GB_DQT>      ; mods = <(MOD_LSFT)>;)
ZMK_MOD_MORPH(lpar_lt,  bindings = <&kp LPAR>, <&kp LT>         ; mods = <(MOD_LSFT)>;)
ZMK_MOD_MORPH(rpar_gt,  bindings = <&kp RPAR>, <&kp GT>         ; mods = <(MOD_LSFT)>;)

NUM_MORPH(eql_left, EQUAL, LEFT)
NUM_MORPH(n4_down, N4, DOWN)
NUM_MORPH(n5_up, N5, UP)
NUM_MORPH(n6_right, N6, RIGHT)
NUM_MORPH(n0_ret, N0, RET)
NUM_MORPH(n7_pgdn, N7, PG_DN)
NUM_MORPH(n8_pgup, N8, PG_UP)
NUM_MORPH(dot_home, DOT, HOME)
NUM_MORPH(n9_end, N9, END)

/* Keymap */
#define LEFT_THUMBS &mo NAV &kp SFT
#define RIGHT_THUMBS &thm CTL SPC &mo SYM
#define LEFT_THUMBS_MAC &mo NAVM &kp SFT
#define RIGHT_THUMBS_MAC &thm GUI SPC &mo SYMM

// LH3 LH4 LH0 LH1 LH2 RH2 RH1 RH0 RH4 RH3
#define LIMONCELLO_THUMBS_L &mt MET TAB &lt SYS GRAVE LEFT_THUMBS &mt ALT ESC
#define LIMONCELLO_THUMBS_R &mt ALT RET RIGHT_THUMBS &lt SYS FSLH &mt SFT BSPC

#if !defined THUMB_CLUSTER
    #define THUMB_CLUSTER LEFT_THUMBS RIGHT_THUMBS
#endif
#define TRANS_THUMBS &trans &trans
#define TRANS_5 &trans &trans &trans &trans &trans

LAYER(Graphite,
  &kp B &kp L &kp D &kp W &kp Z, &sqt_dqt &kp F &kp O    &kp U     &kp J,
  &kp N &kp R &kp T &kp S &kp G, &kp Y    &kp H &kp A    &kp E     &kp I,
  &kp Q &kp X &kp M &kp C &kp V, &kp K    &kp P &dot_col &kp MINUS &com_sem
)

MLAYER(Graphite,
  &kp B &kp L &kp D &kp W &kp Z, &sqt_dqt &kp F &kp O    &kp U     &kp J,
  &kp N &kp R &kp T &kp S &kp G, &kp Y    &kp H &kp A    &kp E     &kp I,
  &kp Q &kp X &kp M &kp C &kp V, &kp K    &kp P &dot_col &kp MINUS &com_sem
)

LAYER(Qwerty,
  &kp Q &kp W &kp E &kp R &kp T, &kp Y &kp U &kp I     &kp O   &kp P,
  &kp A &kp S &kp D &kp F &kp G, &kp H &kp J &kp K     &kp L   &kp SEMI,
  &kp Z &kp X &kp C &kp V &kp B, &kp N &kp M &kp COMMA &kp DOT &kp FSLH
)

MLAYER(Qwerty,
  &kp Q &kp W &kp E &kp R &kp T, &kp Y &kp U &kp I     &kp O   &kp P,
  &kp A &kp S &kp D &kp F &kp G, &kp H &kp J &kp K     &kp L   &kp SEMI,
  &kp Z &kp X &kp C &kp V &kp B, &kp N &kp M &kp COMMA &kp DOT &kp FSLH
)

#if defined GAME_LAYER_KEYS
  ZMK_LAYER(game, GAME_LAYER_KEYS)
#else
  TRANS_LAYER(game)
#endif

LAYER(Nav,
  &alt_tab &kp LS(TAB) &pre_tab &nex_tab &kp PRCNT, &dot_home &n7_pgdn &n8_pgup &n9_end   &kp FSLH,
  &sk SFT  &sk ALT     &sk MET  &sk CTL  &kp STAR,  &eql_left &n4_down &n5_up   &n6_right &n0_ret,
  &vi_sav  &key_repeat &kp TAB  &kp ESC  &kp QMARK, &kp MINUS &kp N1   &kp N2   &kp N3    &kp PLUS
)

MLAYER(Nav,
  &met_tab &trans &trans  &trans  &trans, TRANS_5,
  &trans   &trans &sk CTL &sk MET &trans, TRANS_5,
  TRANS_5, TRANS_5
)

TLAYER(Sym,
  &kp GRAVE &kp LT    &kp LBKT &kp RBKT &kp GT,      &kp HOME &kp PG_DN &kp PG_UP &kp END   &sk RALT,
  SL(EXCL)  AL(GB_AT) ML(LPAR) CL(RPAR) &kp GB_HASH, &kp LEFT &kp DOWN  &kp UP    &kp RIGHT &kp RET,
  &kp AMPS  &kp DLLR  &kp LBRC &kp RBRC &kp CARET,   &del_wor &kp BSPC  &kp DEL   &kp INS   &kp GB_BSLH
)

MLAYER(Sym,
  TRANS_5, TRANS_5,
  &trans &trans CL(LPAR) ML(RPAR) &trans, TRANS_5,
  TRANS_5, &kp LG(BSPC) &trans &trans &trans &trans
)

TLAYER(Fn,
 &kp F1   &kp F2  &kp F3  &kp F4  &kp F5,  &kp F6   &kp F7       &kp F8       &kp F9     &kp F10,
 &sk SFT  &sk ALT &sk MET &sk CTL &kp F11, &kp F12  &kp C_VOL_DN &kp C_VOL_UP &kp C_MUTE &vi_sav,
 &tog SYS &none   &none   &none   &none,   &kp CAPS &kp C_BRI_DN &kp C_BRI_UP &none      &kp PSCRN
)

MLAYER(Fn,
 TRANS_5,TRANS_5,
 &trans  &trans &sk CTL &sk MET &trans, TRANS_5,
 TRANS_5,TRANS_5
)

TLAYER(sys,
  &bt BT_SEL 0 &bt BT_SEL 1 &bt BT_SEL 2 &bt BT_SEL 3 &bt BT_CLR , &bt BT_CLR_ALL &none &none &none    &tog GAME,
  &none        &none        &kp C_BRI_UP &kp C_BRI_DN &sys_reset , &sys_reset     &none &none &tog QWM &tog QW,
  &out OUT_BLE &out OUT_USB &none        &none        &bootloader, &bootloader    &none &none &none    &tog GRM
)

ZMK_CONDITIONAL_LAYER(function_condition, NAV SYM, FN)
ZMK_CONDITIONAL_LAYER(function_condition, NAVM SYMM, FNM)

/* Combos */
SIMPLE_COMBO(degree, &uc_deg, LT4 LM4)

/* Bootloader Combo for sending the "central" into bootloader mode */
SIMPLE_COMBO(bootloader, &bootloader, LT0 LT1 RT1 RT0)
SIMPLE_COMBO(reset, &sys_reset, LT0 RT0)

/* Linux/Win Layers */
MOD_LAYER_COMBO(LCTL, NAV, LH1 LM1)
MOD_LAYER_COMBO(LGUI, NAV, LH1 LM2)
MOD_LAYER_COMBO(LALT, NAV, LH1 LM3)
MOD_LAYER_COMBO(LSFT, NAV, LH1 LM4)
MOD_LAYER_COMBO_2(LGUI, LCTL, NAV, LH1 LM2 LM1)
MOD_LAYER_COMBO_2(LGUI, LALT, NAV, LH1 LM2 LM3)
MOD_LAYER_COMBO_2(LGUI, LSFT, NAV, LH1 LM2 LM4)
MOD_LAYER_COMBO_2(LCTL, LALT, NAV, LH1 LM1 LM3)
MOD_LAYER_COMBO_2(LCTL, LSFT, NAV, LH1 LM1 LM4)

MOD_LAYER_COMBO(LCTL,  SYM, RH1 LM1)
MOD_LAYER_COMBO(LGUI,  SYM, RH1 LM2)
MOD_LAYER_COMBO(LALT,  SYM, RH1 LM3)
MOD_LAYER_COMBO(LSFT,  SYM, RH1 LM4)
MOD_LAYER_COMBO_2(LGUI, LCTL, SYM, RH1 LM2 LM1)
MOD_LAYER_COMBO_2(LGUI, LALT, SYM, RH1 LM2 LM3)
MOD_LAYER_COMBO_2(LGUI, LSFT, SYM, RH1 LM2 LM4)
MOD_LAYER_COMBO_2(LCTL, LALT, SYM, RH1 LM1 LM3)
MOD_LAYER_COMBO_2(LCTL, LSFT, SYM, RH1 LM1 LM4)

/* For the Mac Layers */
MOD_LAYER_COMBO(LGUI, NAVM, LH1 LM1)
MOD_LAYER_COMBO(LCTL, NAVM, LH1 LM2)
MOD_LAYER_COMBO(LALT, NAVM, LH1 LM3)
MOD_LAYER_COMBO(LSFT, NAVM, LH1 LM4)
MOD_LAYER_COMBO_2(LGUI, LCTL, NAVM, LH1 LM2 LM1)
MOD_LAYER_COMBO_2(LCTL, LALT, NAVM, LH1 LM2 LM3)
MOD_LAYER_COMBO_2(LCTL, LSFT, NAVM, LH1 LM2 LM4)
MOD_LAYER_COMBO_2(LGUI, LALT, NAVM, LH1 LM1 LM3)
MOD_LAYER_COMBO_2(LGUI, LSFT, NAVM, LH1 LM1 LM4)

MOD_LAYER_COMBO(LGUI,  SYMM, RH1 LM1)
MOD_LAYER_COMBO(LCTL,  SYMM, RH1 LM2)
MOD_LAYER_COMBO(LALT,  SYMM, RH1 LM3)
MOD_LAYER_COMBO(LSFT,  SYMM, RH1 LM4)
MOD_LAYER_COMBO_2(LGUI, LCTL, SYMM, RH1 LM2 LM1)
MOD_LAYER_COMBO_2(LCTL, LALT, SYMM, RH1 LM2 LM3)
MOD_LAYER_COMBO_2(LCTL, LSFT, SYMM, RH1 LM2 LM4)
MOD_LAYER_COMBO_2(LGUI, LALT, SYMM, RH1 LM1 LM3)
MOD_LAYER_COMBO_2(LGUI, LSFT, SYMM, RH1 LM1 LM4)

// vi:ft=devicetree
